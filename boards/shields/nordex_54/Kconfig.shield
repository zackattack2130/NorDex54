## boards/shields/nordex_54/Kconfig.shield
```kconfig
config SHIELD_NORDEX_54_LEFT
    def_bool $(shields_list_contains,nordex_54_left)
  
config SHIELD_NORDEX_54_RIGHT
    def_bool $(shields_list_contains,nordex_54_right)
  
```
